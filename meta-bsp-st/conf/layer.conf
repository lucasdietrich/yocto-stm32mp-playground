## meta-bsp-st/conf/machine/mp2.conf
```bitbake
#@TYPE: Machine
#@NAME: stm32mp257-dk machine
#@DESCRIPTION: Machine configuration for the STM32MP257-DK board

DEFAULTTUNE = "cortexa35"
include conf/machine/include/arm/armv8a/tune-cortexa35.inc

# MACHINE_FEATURES += "bluetooth"
# MACHINE_FEATURES += "wifi"

KERNEL_IMAGETYPE = "Image"

IMAGE_FSTYPES = "ext4"

PREFERRED_PROVIDER_virtual/tf-a = "tf-a-st"
PREFERRED_PROVIDER_virtual/kernel = "linux-amy"
PREFERRED_PROVIDER_virtual/u-boot = "u-boot"
PREFERRED_PROVIDER_virtual/optee-os = "optee-os-st"

PREFERRED_VERSION_tf-a-st = "2.10.24"
PREFERRED_VERSION_u-boot = "2026.04"
PREFERRED_VERSION_linux-amy = "7.0.%"

SERIAL_CONSOLES = "115200;ttySTM0"

# TODO use consistent naming
TFA_DEVICETREE = "stm32mp257f-dk"
KERNEL_DEVICETREE = "st/stm32mp257f-dk.dtb"

# u-boot
UBOOT_CONFIG = "stm32mp25_defconfig"
UBOOT_DEVICETREE = "st/stm32mp257f-dk"

SDIMAGE_CONF = "sdcard_genimage_mp2.cfg.in"

OPTEE_DEBUG = "0"
```

## meta-bsp-st/recipes-support/swupdate/files/defconfig
```kconfig
CONFIG_HAVE_LINUX=y
CONFIG_HAVE_LUA=y
CONFIG_HAVE_LIBCONFIG=y
CONFIG_HAVE_LIBARCHIVE=y
CONFIG_HAVE_LIBCURL=y
CONFIG_HAVE_LIBFDISK=y
CONFIG_HAVE_LIBBLKID=y
CONFIG_HAVE_LIBGPIOD=y
CONFIG_HAVE_LIBMTD=y
CONFIG_HAVE_LIBUBI=y
CONFIG_HAVE_LIBUBOOTENV=y
CONFIG_HAVE_LIBEBGENV=y
CONFIG_HAVE_LIBTEGRABOOT_TOOLS=y
CONFIG_HAVE_LIBEXT2FS=y
CONFIG_HAVE_LIBBTRFS=y
CONFIG_HAVE_LIBZEROMQ=y
CONFIG_HAVE_ZLIB=y
CONFIG_HAVE_ZSTD=y
CONFIG_HAVE_LIBSSL=y
CONFIG_HAVE_LIBSYSTEMD=y
CONFIG_HAVE_LIBCRYPTO=y
CONFIG_HAVE_WOLFSSL=y
CONFIG_HAVE_MBEDTLS=y
CONFIG_HAVE_P11KIT=y
CONFIG_HAVE_LIBWEBSOCKETS=y
CONFIG_HAVE_LIBRSYNC=y
CONFIG_HAVE_URIPARSER=y
CONFIG_HAVE_ZCK=y

#
# SWUpdate Settings
#

#
# General Configuration
#
# CONFIG_SYSTEMD is not set
CONFIG_DEFAULT_CONFIG_FILE="/etc/swupdate.cfg"
CONFIG_SCRIPTS=y
CONFIG_HW_COMPATIBILITY=y
CONFIG_HW_COMPATIBILITY_FILE="/etc/hwrevision"
CONFIG_SW_VERSIONS_FILE="/etc/sw-versions"

#
# Socket Paths
#
CONFIG_SOCKET_CTRL_PATH=""
CONFIG_SOCKET_PROGRESS_PATH=""
# end of Socket Paths

CONFIG_MTD=y
CONFIG_LUA=y
CONFIG_LUAPKG="lua"
# end of General Configuration

#
# Build Options
#
CONFIG_CROSS_COMPILE=""
CONFIG_SYSROOT=""
CONFIG_EXTRA_CFLAGS=""
CONFIG_EXTRA_LDFLAGS=""
CONFIG_EXTRA_LDLIBS=""
# end of Build Options

#
# Debugging Options
#
# CONFIG_DEBUG is not set
# CONFIG_WERROR is not set
# CONFIG_NOCLEANUP is not set
# end of Debugging Options
# end of SWUpdate Settings

#
# Bootloader support
#

#
# Bootloader Interfaces
#
# CONFIG_BOOTLOADER_NONE is not set
# CONFIG_BOOTLOADER_EBG is not set
CONFIG_UBOOT=y
CONFIG_UBOOT_FWENV="/etc/fw_env.config"
CONFIG_UBOOT_DEFAULTENV="/etc/u-boot-initial-env"
# CONFIG_BOOTLOADER_GRUB is not set
# CONFIG_BOOTLOADER_CBOOT is not set
# end of Bootloader Interfaces

CONFIG_BOOTLOADER_DEFAULT_UBOOT=y
# CONFIG_BOOTLOADER_STATIC_LINKED is not set
CONFIG_UPDATE_STATE_CHOICE_BOOTLOADER=y
CONFIG_UPDATE_STATE_BOOTLOADER="ustate"

#
# Interfaces
#
# CONFIG_DOWNLOAD is not set
# CONFIG_SURICATTA is not set
CONFIG_WEBSERVER=y
CONFIG_MONGOOSE=y
CONFIG_MONGOOSEIPV6=y
CONFIG_MONGOOSESSL=y

#
# Security
#
# CONFIG_SSL_IMPL_NONE is not set
CONFIG_SSL_IMPL_OPENSSL=y
# CONFIG_SSL_IMPL_WOLFSSL is not set
# CONFIG_SSL_IMPL_MBEDTLS is not set
CONFIG_HASH_VERIFY=y
# CONFIG_SIGNED_IMAGES is not set
# CONFIG_ENCRYPTED_IMAGES is not set

#
# Compressors (zlib always on)
#
CONFIG_GUNZIP=y
CONFIG_ZSTD=y

#
# Parsers
#

#
# Parser Features
#
CONFIG_LIBCONFIG=y
CONFIG_PARSERROOT=""
# CONFIG_LUAEXTERNAL is not set
# CONFIG_SETSWDESCRIPTION is not set
# end of Parser Features

#
# Handlers
#

#
# Image Handlers
#
# CONFIG_ARCHIVE is not set
# CONFIG_BOOTLOADERHANDLER is not set
CONFIG_CFI=y
# CONFIG_CFIHAMMING1 is not set
# CONFIG_COPY is not set
# CONFIG_DELTA is not set
# CONFIG_DISKPART is not set
# CONFIG_DISKFORMAT_HANDLER is not set
CONFIG_LUASCRIPTHANDLER=y
# CONFIG_EMBEDDED_LUA_HANDLER is not set
# CONFIG_EMMC_HANDLER is not set
CONFIG_RAW=y
# CONFIG_RDIFFHANDLER is not set
# CONFIG_READBACKHANDLER is not set
# CONFIG_REMOTE_HANDLER is not set
CONFIG_SHELLSCRIPTHANDLER=y
# CONFIG_SWUFORWARDER_HANDLER is not set
# CONFIG_SSBLSWITCH is not set
# CONFIG_UBIVOL is not set
# CONFIG_UCFWHANDLER is not set
# CONFIG_UNIQUEUUID is not set
# end of Image Handlers

#
# Containers
#

#
# Update containers
#
# CONFIG_DOCKER is not set
# end of Update containers
```

## meta-playground/conf/distro/amy.conf
```bitbake
require conf/distro/poky.conf

DISTRO = "amy"
DISTRO_VERSION = "1.0"
DISTRO_NAME = "Amy distribution"

PACKAGE_CLASSES = "package_rpm"

INIT_MANAGER = "sysvinit"
DISTRO_FEATURES += "sysvinit"

DISTRO_FEATURES += "virtualization"
DISTRO_FEATURES += "seccomp"

DISTRO_EXTRA_RDEPENDS += ""
DISTRO_EXTRA_RRECOMMENDS += ""
```

## meta-playground/conf/layer.conf
```bitbake
# We have a conf and classes directory, add to BBPATH
BBPATH .= ":${LAYERDIR}"

# We have recipes-* directories, add to BBFILES
BBFILES += "${LAYERDIR}/recipes-*/*/*.bb \
            ${LAYERDIR}/recipes-*/*/*.bbappend"

BBFILE_COLLECTIONS += "meta-playground"
BBFILE_PATTERN_meta-playground = "^${LAYERDIR}/"
BBFILE_PRIORITY_meta-playground = "6"

LAYERDEPENDS_meta-playground = "core"
LAYERSERIES_COMPAT_meta-playground = "scarthgap wrynose"

DISTRO ?= "amy"

AMY_DEBUG_UTILS ??= "1"
AMY_DEBUG_SSH ??= "1"

RUST_PANIC_STRATEGY:class-target ?= "abort"

# user/group
USERADD_UID_TABLES += "files/playground-passwd"
USERADD_GID_TABLES += "files/playground-group"

USERADDEXTENSION = "useradd-staticids"
USERADD_ERROR_DYNAMIC = "error"

PREFERRED_PROVIDER_virtual/runc = "crun"
```
